## boards/shields/skeletyl/Kconfig.shield
```kconfig
# Copyright (c) 2020 The ZMK Contributors
# SPDX-License-Identifier: MIT

config SHIELD_SKELETYL_LEFT
    def_bool $(shields_list_contains,skeletyl_left)

config SHIELD_SKELETYL_RIGHT
    def_bool $(shields_list_contains,skeletyl_right)

config SHIELD_SKELETYL_V2_LEFT
    def_bool $(shields_list_contains,skeletyl_v2_left)

config SHIELD_SKELETYL_V2_RIGHT
    def_bool $(shields_list_contains,skeletyl_v2_right)
```
